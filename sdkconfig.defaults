## sdkconfig.defaults
```kconfig
# Galena Action Ring — sdkconfig.defaults

# Target
CONFIG_IDF_TARGET="esp32s3"

# TinyUSB — HID only (no CDC)
CONFIG_TINYUSB_HID_COUNT=1

# Custom VID, Default PID (auto = 0x4004 for HID-only)
# Espressif VID 0x303A is used by default
# Default PID auto-computes to avoid conflicts with old CDC firmware

# ESP-NOW / WiFi
CONFIG_ESP_WIFI_ESPNOW_MAX_ENCRYPT_NUM=0

# Log level
CONFIG_LOG_DEFAULT_LEVEL_INFO=y

# Disable USB Serial/JTAG driver to free PHY for TinyUSB OTG
# CONFIG_USJ_ENABLE_USB_SERIAL_JTAG is not set

# No secondary console (UART primary only)
CONFIG_ESP_CONSOLE_SECONDARY_NONE=y
```
